## conf/layer.conf
```bitbake
# We have a conf and classes directory, add to BBPATH
BBPATH .= ":${LAYERDIR}"

# We have recipes-* directories, add to BBFILES
BBFILES += "${LAYERDIR}/recipes-*/*/*.bb \
            ${LAYERDIR}/recipes-*/*/*.bbappend"

BBFILE_COLLECTIONS += "meta-apps-demo"
BBFILE_PATTERN_meta-apps-demo = "^${LAYERDIR}/"
BBFILE_PRIORITY_meta-apps-demo = "6"

LAYERDEPENDS_meta-apps-demo = "core"
LAYERSERIES_COMPAT_meta-apps-demo = "kirkstone"
```
